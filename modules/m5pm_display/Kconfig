## modules/m5pm_display/Kconfig
```kconfig
menu "M5PaperMono display test"
config M5PM_FRONTLIGHT_PERCENT
    int "Frontlight duty percent"
    range 0 100
    default 100
config M5PM_PANEL_STATE
    int "Panel state (0 idle, 1 deep sleep, 2 power off)"
    range 0 2
    default 0
endmenu
```

## modules/m5pm_lora/Kconfig
```kconfig
menu "M5PaperMono LoRa test"
config M5PM_LORA_RUNTIME_SECONDS
    int "Periodic TX hard runtime limit (s)"
    range 1 86400
    default 600
endmenu
```

## modules/m5pm_test_support/Kconfig
```kconfig
menu "M5PaperMono test support"

    config M5PM_TEST_ID
        string "Stable test identifier"
        default "unset"

    config M5PM_CONFIG_ID
        string "Stable test configuration identifier"
        default "unset"

endmenu
```

## modules/m5pm_wifi/Kconfig
```kconfig
menu "M5PaperMono Wi-Fi test"
config M5PM_WIFI_SSID
    string "STA SSID"
    default ""
config M5PM_WIFI_PASSWORD
    string "STA password"
    default ""
config M5PM_WIFI_PING_TARGET
    string "Fixed LAN ICMP target"
    default "192.168.1.1"
config M5PM_WIFI_CONNECT_TIMEOUT_MS
    int "Connection timeout (ms)"
    default 15000
endmenu
```

## tests/display_refresh_modes/main/Kconfig.projbuild
```kconfig
choice M5PM_DISPLAY_REFRESH_MODE
    prompt "SSD1677 refresh mode"
    default M5PM_DISPLAY_EPD_FASTEST
    config M5PM_DISPLAY_EPD_FASTEST
        bool "Fastest"
    config M5PM_DISPLAY_EPD_FAST
        bool "Fast"
    config M5PM_DISPLAY_EPD_QUALITY
        bool "Quality"
endchoice
```

## tests/frontlight_levels/main/Kconfig.projbuild
```kconfig
choice M5PM_FRONTLIGHT_LEVEL
    prompt "Frontlight level"
    default M5PM_FRONTLIGHT_0
    config M5PM_FRONTLIGHT_0
        bool "0 percent"
    config M5PM_FRONTLIGHT_50
        bool "50 percent"
    config M5PM_FRONTLIGHT_100
        bool "100 percent"
endchoice
```

## tests/frontlight_levels/sdkconfig.defaults
```kconfig
CONFIG_IDF_TARGET="esp32s3"
CONFIG_ESPTOOLPY_FLASHSIZE_16MB=y
CONFIG_SPIRAM=y
CONFIG_SPIRAM_MODE_OCT=y
CONFIG_SPIRAM_SPEED_80M=y
CONFIG_M5PM_TEST_ID="frontlight_levels"
CONFIG_M5PM_CONFIG_ID="frontlight-0"
CONFIG_M5PM_FRONTLIGHT_0=y
```

## tests/full_load/main/Kconfig.projbuild
```kconfig
menu "M5PaperMono full-load safety"

    config M5PM_FULL_LOAD_ENABLE
        bool "Enable the full-load test"
        default n
        help
            Keep this disabled until the implementation, current limit,
            temperature limit, hard timeout, and stop controls are validated.

endmenu

menu "M5PaperMono full-load network"
config M5PM_FULL_LOAD_WIFI_SSID
    string "Wi-Fi SSID"
    default ""
config M5PM_FULL_LOAD_WIFI_PASSWORD
    string "Wi-Fi password"
    default ""
config M5PM_FULL_LOAD_RUNTIME_SECONDS
    int "Maximum runtime (seconds)"
    range 1 3600
    default 600
endmenu
```

## tests/l0_shutdown/sdkconfig.defaults
```kconfig
# ESP-IDF 5.5.5 defaults for M5PaperMono.
CONFIG_IDF_TARGET="esp32s3"
CONFIG_ESPTOOLPY_FLASHSIZE_16MB=y
CONFIG_ESPTOOLPY_HEADER_FLASHSIZE_UPDATE=y
CONFIG_SPIRAM=y
CONFIG_SPIRAM_MODE_OCT=y
CONFIG_SPIRAM_SPEED_80M=y
CONFIG_SPIRAM_USE_MALLOC=y
CONFIG_ESP_DEFAULT_CPU_FREQ_MHZ_240=y
CONFIG_COMPILER_WARN_WRITE_STRINGS=y
CONFIG_COMPILER_CXX_EXCEPTIONS=n
CONFIG_COMPILER_CXX_RTTI=n
CONFIG_M5PM_TEST_ID="l0_shutdown"
CONFIG_M5PM_CONFIG_ID="l0_shutdown"
```

## tests/lora_rx_idle/sdkconfig.defaults
```kconfig
CONFIG_IDF_TARGET="esp32s3"
CONFIG_ESPTOOLPY_FLASHSIZE_16MB=y
CONFIG_SPIRAM=y
CONFIG_SPIRAM_MODE_OCT=y
CONFIG_SPIRAM_SPEED_80M=y
CONFIG_M5PM_TEST_ID="lora_rx_idle"
CONFIG_M5PM_CONFIG_ID="lora_rx_idle"
CONFIG_FREERTOS_HZ=1000
```

## tests/lora_sleep/sdkconfig.defaults
```kconfig
CONFIG_IDF_TARGET="esp32s3"
CONFIG_ESPTOOLPY_FLASHSIZE_16MB=y
CONFIG_SPIRAM=y
CONFIG_SPIRAM_MODE_OCT=y
CONFIG_SPIRAM_SPEED_80M=y
CONFIG_M5PM_TEST_ID="lora_sleep"
CONFIG_M5PM_CONFIG_ID="lora_sleep"
CONFIG_FREERTOS_HZ=1000
```

## tests/nfc_working_current/main/Kconfig.projbuild
```kconfig
menu "M5PaperMono NFC current"
choice M5PM_NFC_MODE
    prompt "NFC operating mode"
    default M5PM_NFC_MODE_POWER_DOWN
    config M5PM_NFC_MODE_POWER_DOWN
        bool "Power down"
    config M5PM_NFC_MODE_NFC_A_POLLING
        bool "NFC-A polling"
endchoice
endmenu
```

## tests/nfc_working_current/sdkconfig.defaults
```kconfig
# ESP-IDF 5.5.5 defaults for M5PaperMono.
CONFIG_IDF_TARGET="esp32s3"
CONFIG_ESPTOOLPY_FLASHSIZE_16MB=y
CONFIG_ESPTOOLPY_HEADER_FLASHSIZE_UPDATE=y
CONFIG_SPIRAM=y
CONFIG_SPIRAM_MODE_OCT=y
CONFIG_SPIRAM_SPEED_80M=y
CONFIG_SPIRAM_USE_MALLOC=y
CONFIG_ESP_DEFAULT_CPU_FREQ_MHZ_240=y
CONFIG_COMPILER_WARN_WRITE_STRINGS=y
CONFIG_COMPILER_CXX_EXCEPTIONS=n
CONFIG_COMPILER_CXX_RTTI=n
CONFIG_M5PM_TEST_ID="nfc_working_current"
CONFIG_M5PM_NFC_MODE_POWER_DOWN=y
# CONFIG_M5PM_NFC_MODE_NFC_A_POLLING is not set
CONFIG_PARTITION_TABLE_CUSTOM=y
CONFIG_PARTITION_TABLE_CUSTOM_FILENAME="partitions.csv"
CONFIG_PARTITION_TABLE_FILENAME="partitions.csv"
```

## tests/wifi_light_sleep/sdkconfig.defaults
```kconfig
CONFIG_IDF_TARGET="esp32s3"
CONFIG_ESPTOOLPY_FLASHSIZE_16MB=y
CONFIG_SPIRAM=y
CONFIG_SPIRAM_MODE_OCT=y
CONFIG_SPIRAM_SPEED_80M=y
CONFIG_M5PM_TEST_ID="wifi_light_sleep"
CONFIG_M5PM_CONFIG_ID="wifi_light_sleep"
CONFIG_ESP_DEFAULT_CPU_FREQ_MHZ_240=y
CONFIG_PM_ENABLE=y
CONFIG_FREERTOS_USE_TICKLESS_IDLE=y
CONFIG_FREERTOS_HZ=1000
CONFIG_FREERTOS_IDLE_TIME_BEFORE_SLEEP=3
CONFIG_PM_SLP_IRAM_OPT=y
CONFIG_PM_RTOS_IDLE_OPT=y
CONFIG_PM_POWER_DOWN_CPU_IN_LIGHT_SLEEP=y
CONFIG_ESP_WIFI_SLP_IRAM_OPT=y
```
